## conf/bblayers.conf
```bitbake
# LAYER_CONF_VERSION is increased each time build/conf/bblayers.conf
# changes incompatibly
LCONF_VERSION = "7"
OEROOT := "${@os.path.abspath(os.path.dirname(d.getVar('FILE', True)))}/.."

BBPATH = "${TOPDIR}"

BBFILES = ""

# These layers hold recipe metadata not found in OE-core, but lack any machine or distro content
BASELAYERS ?= " \
  ${OEROOT}/../meta-openembedded/meta-oe \
  ${OEROOT}/../meta-openembedded/meta-gnome \
  ${OEROOT}/../meta-openembedded/meta-xfce \
  ${OEROOT}/../meta-openembedded/meta-initramfs \
  ${OEROOT}/../meta-openembedded/meta-multimedia \
  ${OEROOT}/../meta-openembedded/meta-networking \
  ${OEROOT}/../meta-openembedded/meta-webserver \
  ${OEROOT}/../meta-openembedded/meta-filesystems \
  ${OEROOT}/../meta-openembedded/meta-perl \
  ${OEROOT}/../meta-openembedded/meta-python \
  ${OEROOT}/../meta-rust \
  ${OEROOT}/../meta-qt5 \
  ${OEROOT}/../meta-noto \
"

# These layers hold machine specific content, aka Board Support Packages
BSPLAYERS ?= " \
  ${OEROOT}/../meta-altera \
  ${OEROOT}/../meta-xilinx/meta-xilinx-bsp \
  ${OEROOT}/../meta-xilinx-tools \
  ${OEROOT}/../meta-fluke-cda \
"
#  ${OEROOT}/../meta-xilinx/meta-xilinx-core \
#

# Add your overlay location to EXTRALAYERS
# Make sure to have a conf/layers.conf in there
EXTRALAYERS ?= " \
"

BBLAYERS = " \
  ${OEROOT}/../meta \
  ${OEROOT}/../meta-poky \
  ${BASELAYERS} \
  ${BSPLAYERS} \
  ${EXTRALAYERS} \
"
```
